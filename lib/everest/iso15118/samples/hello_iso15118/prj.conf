## CMakeLists.txt
```
# SPDX-License-Identifier: Apache-2.0
# Copyright 2026 Pionix GmbH and Contributors to EVerest
#
# Smoke test for the libiso15118 Zephyr module wiring
cmake_minimum_required(VERSION 3.20.0)
find_package(Zephyr REQUIRED HINTS $ENV{ZEPHYR_BASE})
project(hello_iso15118)

target_sources(app PRIVATE src/main.cpp)
target_link_libraries(app PRIVATE iso15118::iso15118)
```

## Kconfig
```
# SPDX-License-Identifier: Apache-2.0
# Copyright 2026 Pionix GmbH and Contributors to EVerest

mainmenu "hello_iso15118 sample"

config APP_WIFI_STA
	bool "Associate with a WiFi access point (station mode) at startup"
	depends on WIFI
	default y
	help
	  Before starting the ISO 15118 controller, main() connects to the
	  access point named by APP_WIFI_SSID and hands the resulting WiFi
	  interface to libiso15118. On a build without WIFI (e.g. native_sim)
	  this is compiled out and the controller falls back to APP_IFACE_NAME.

if APP_WIFI_STA

config APP_WIFI_SSID
	string "WiFi SSID"
	default "changeme"

config APP_WIFI_PSK
	string "WiFi PSK (leave empty for an open network)"
	default ""

config APP_WIFI_CONNECT_TIMEOUT_S
	int "Seconds to wait for association / link-local address"
	default 30

endif # APP_WIFI_STA

config APP_IFACE_NAME
	string "Network interface libiso15118 binds to when APP_WIFI_STA is unset"
	default "eth0"
	help
	  Only used for non-WiFi builds. The WiFi path discovers the interface
	  name at runtime (it is "wlan0" on this SoC, not "eth0").

source "Kconfig.zephyr"
```

## prj.conf
```kconfig
CONFIG_STD_CPP17=y
CONFIG_ISO15118=y
```

## boards/xiao_esp32c6_esp32c6_hpcore.conf
```kconfig
# SPDX-License-Identifier: Apache-2.0
# Copyright 2026 Pionix GmbH and Contributors to EVerest
#
# Board-specific overrides for Seeed XIAO ESP32C6 (RISC-V "hpcore", the application core - see
# west build -b xiao_esp32c6/esp32c6/hpcore). The base prj.conf already builds and links here
# without any board-specific config (entropy is a real hardware RNG on this SoC, unlike e.g.
# qemu_cortex_m3 which has none and fails to link without one).
#
# This board has no Ethernet MAC, so its network transport for an ISO 15118 session is WiFi in
# station mode. main() associates with CONFIG_APP_WIFI_SSID at startup (see ../Kconfig and
# ../src/main.cpp) and then hands the "wlan0" interface to libiso15118.

# --- WiFi driver (ESP32-C6 is single-core RISC-V, so WIFI_ESP32's !SMP dependency is met).
# WIFI_ESP32 already selects NET_L2_WIFI_MGMT, NET_L2_ETHERNET, MBEDTLS and PSA_CRYPTO.
CONFIG_WIFI=y
CONFIG_WIFI_ESP32=y
CONFIG_NET_L2_WIFI_MGMT=y
CONFIG_ESP32_WIFI_STA_RECONNECT=y

# --- net_mgmt event delivery: needed for the NET_EVENT_WIFI_CONNECT_RESULT callback in main(),
# and INFO carries the association status code.
CONFIG_NET_MGMT=y
CONFIG_NET_MGMT_EVENT=y
CONFIG_NET_MGMT_EVENT_INFO=y

# --- IPv6 for ISO 15118. NET_IPV6 itself comes in via CONFIG_ISO15118 (POSIX_IPV6). SDP is
# link-local multicast only, so make sure DAD, MLD (to join ff02::x) and the neighbour cache
# are in, and leave room for link-local plus any global address the AP's router hands out.
CONFIG_NET_IPV6_DAD=y
CONFIG_NET_IPV6_MLD=y
CONFIG_NET_IPV6_NBR_CACHE=y
CONFIG_NET_IF_MAX_IPV6_COUNT=3

# --- Heap. The ESP WiFi blob adds ~50K of its own (HEAP_MEM_POOL_ADD_SIZE_ESP_WIFI);
# bump the shared pool above libiso15118's 32K default to cover it plus the D20 allocations.
CONFIG_HEAP_MEM_POOL_SIZE=131072

# --- Stacks. Zephyr's defaults (main 4K, sysworkq 1K, idle 512, ISR 2K) are far too small for
# libiso15118's C++ construction path (iostream logging, std::string/vector, exceptions) running
# on top of the ESP32 WiFi driver plus the IPv6/MLD/DAD net stack, which offloads work onto the
# system workqueue. With no stack guard on this config an overflow silently corrupts globals and
# faults somewhere unrelated, so keep generous headroom here.
CONFIG_MAIN_STACK_SIZE=16384
CONFIG_SYSTEM_WORKQUEUE_STACK_SIZE=4096
CONFIG_IDLE_STACK_SIZE=1024
CONFIG_ISR_STACK_SIZE=4096

# --- Packet buffers, sized for V2GTP/TLS-off session traffic.
CONFIG_NET_PKT_RX_COUNT=16
CONFIG_NET_PKT_TX_COUNT=16
CONFIG_NET_BUF_RX_COUNT=32
CONFIG_NET_BUF_TX_COUNT=32

# --- WiFi credentials. Override per checkout, e.g. via a board .conf fragment or
# `west build ... -- -DCONFIG_APP_WIFI_PSK=\"...\"`; do not commit real credentials.
CONFIG_APP_WIFI_SSID="changeme"
CONFIG_APP_WIFI_PSK=""

# --- Optional: `net iface` / `wifi` shell commands on the USB console for bring-up debugging.
# Drop these two lines to shrink the image once the link is proven.
CONFIG_SHELL=y
CONFIG_NET_SHELL=y
```

## src/main.cpp
```c
// SPDX-License-Identifier: Apache-2.0
// Copyright 2026 Pionix GmbH and Contributors to EVerest

#include <iostream>
#include <memory>
#include <string>

#include <iso15118/io/logging.hpp>
#include <iso15118/tbd_controller.hpp>

#include <cstdint>
#include <cstring>

#include <zephyr/kernel.h>
#include <zephyr/net/net_if.h>
#include <zephyr/net/net_ip.h>
#include <zephyr/net/net_mgmt.h>
#include <zephyr/net/wifi_mgmt.h>

namespace {

K_SEM_DEFINE(wifi_associated, 0, 1);

net_mgmt_event_callback wifi_cb;

void wifi_event_handler(net_mgmt_event_callback* cb, uint64_t event, net_if* /*iface*/) {
    if (event != NET_EVENT_WIFI_CONNECT_RESULT) {
        return;
    }

    const auto* status = static_cast<const wifi_status*>(cb->info);
    if (status != nullptr && status->status != 0) {
        std::cout << "wifi: association failed (status " << status->status << ")\n";
        return;
    }

    k_sem_give(&wifi_associated);
}

// Associate with CONFIG_APP_WIFI_SSID in station mode and wait for a usable IPv6
// link-local address.
// Returns the interface name libiso15118 should bind to, or "" on failure.
std::string setup_network() {
    net_if* iface = net_if_get_first_wifi();
    if (iface == nullptr) {
        std::cout << "wifi: no WiFi interface present\n";
        return {};
    }

    net_mgmt_init_event_callback(&wifi_cb, wifi_event_handler, NET_EVENT_WIFI_CONNECT_RESULT);
    net_mgmt_add_event_callback(&wifi_cb);

    const char* const ssid = CONFIG_APP_WIFI_SSID;
    const char* const psk = CONFIG_APP_WIFI_PSK;
    const bool open_network = std::strlen(psk) == 0;

    wifi_connect_req_params params{};
    params.ssid = reinterpret_cast<const uint8_t*>(ssid);
    params.ssid_length = std::strlen(ssid);
    params.security = open_network ? WIFI_SECURITY_TYPE_NONE : WIFI_SECURITY_TYPE_PSK;
    if (!open_network) {
        params.psk = reinterpret_cast<const uint8_t*>(psk);
        params.psk_length = std::strlen(psk);
    }
    params.channel = WIFI_CHANNEL_ANY;
    params.band = WIFI_FREQ_BAND_2_4_GHZ; // ESP32-C6 is 2.4 GHz only
    params.mfp = WIFI_MFP_OPTIONAL;

    std::cout << "wifi: connecting to \"" << ssid << "\"...\n";
    if (net_mgmt(NET_REQUEST_WIFI_CONNECT, iface, &params, sizeof(params)) != 0) {
        std::cout << "wifi: connect request rejected\n";
        return {};
    }

    if (k_sem_take(&wifi_associated, K_SECONDS(CONFIG_APP_WIFI_CONNECT_TIMEOUT_S)) != 0) {
        std::cout << "wifi: association timed out\n";
        return {};
    }
    std::cout << "wifi: associated\n";

    // Wait for the link-local address to pass duplicate address detection.
    const int64_t deadline = k_uptime_get() + (CONFIG_APP_WIFI_CONNECT_TIMEOUT_S * 1000);
    const net_in6_addr* ll = nullptr;
    while ((ll = net_if_ipv6_get_ll(iface, NET_ADDR_PREFERRED)) == nullptr) {
        if (k_uptime_get() > deadline) {
            std::cout << "wifi: no link-local address after DAD\n";
            return {};
        }
        k_msleep(100);
    }

    char if_name[CONFIG_NET_INTERFACE_NAME_LEN + 1] = {};
    if (net_if_get_name(iface, if_name, sizeof(if_name)) < 0) {
        std::cout << "wifi: could not read interface name\n";
        return {};
    }

    char addr_str[NET_IPV6_ADDR_LEN] = {};
    net_addr_ntop(AF_INET6, ll, addr_str, sizeof(addr_str));
    std::cout << "wifi: " << if_name << " ready, link-local " << addr_str << "\n";

    return if_name;
}

const char* signal_name(iso15118::session::feedback::Signal signal) {
    using S = iso15118::session::feedback::Signal;
    switch (signal) {
    case S::REQUIRE_AUTH_EIM:
        return "REQUIRE_AUTH_EIM";
    case S::START_CABLE_CHECK:
        return "START_CABLE_CHECK";
    case S::SETUP_FINISHED:
        return "SETUP_FINISHED";
    case S::PRE_CHARGE_STARTED:
        return "PRE_CHARGE_STARTED";
    case S::CHARGE_LOOP_STARTED:
        return "CHARGE_LOOP_STARTED";
    case S::CHARGE_LOOP_FINISHED:
        return "CHARGE_LOOP_FINISHED";
    case S::DC_OPEN_CONTACTOR:
        return "DC_OPEN_CONTACTOR";
    case S::AC_CLOSE_CONTACTOR:
        return "AC_CLOSE_CONTACTOR";
    case S::AC_OPEN_CONTACTOR:
        return "AC_OPEN_CONTACTOR";
    case S::DLINK_TERMINATE:
        return "DLINK_TERMINATE";
    case S::DLINK_ERROR:
        return "DLINK_ERROR";
    case S::DLINK_PAUSE:
        return "DLINK_PAUSE";
    }
    return "unknown";
}

} // namespace

int main() {

    using namespace iso15118;

    std::unique_ptr<TbdController> controller;

    io::set_logging_callback([](LogLevel level, const std::string& message) {
        std::cout << "log(" << static_cast<int>(level) << "): " << message << "\n";
    });

    TbdConfig config{};
    config.enable_sdp_server = true;

    config.interface_name = setup_network();
    if (config.interface_name.empty()) {
        std::cout << "network setup failed, aborting\n";
        return 1;
    }

    session::feedback::Callbacks callbacks{};
    callbacks.signal = [](session::feedback::Signal signal) {
        std::cout << "log: signal received: " << signal_name(signal) << "\n";
    };

    d20::EvseSetupConfig evse_config{};

    controller = std::make_unique<TbdController>(std::move(config), std::move(callbacks), std::move(evse_config));

    controller->set_dlink_ready(true);

    controller->loop();
    return 0;
}
```
